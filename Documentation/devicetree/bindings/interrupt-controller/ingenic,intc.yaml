## module_drivers/Kconfig
```kconfig
# SPDX-License-Identifier: GPL-2.0
menu "Ingenic SDK drivers (module_drivers)"

source "module_drivers/drivers/Kconfig"

endmenu
```

## module_drivers/drivers/Kconfig
```kconfig
# SPDX-License-Identifier: GPL-2.0
menu "[OST] clocksoure Drivers"
source "module_drivers/drivers/clocksource/Kconfig"
endmenu
```

## module_drivers/drivers/char/Kconfig
```kconfig
# SPDX-License-Identifier: GPL-2.0
config INGENIC_HW_RANDOM
	tristate "[RANDOM] Ingenic Random Driver"
	depends on MIPS
	depends on HW_RANDOM
	help
	  This driver provides kernel-side support for the Random Number
	  Generator hardware found on Ingenic processors.

	  To compile this driver as a module, choose M here: the
	  module will be called ingenic-rng.

	  If unsure, say N.
```

## module_drivers/drivers/clk/ingenic-v2/Kconfig
```kconfig
# SPDX-License-Identifier: GPL-2.0
config COMMON_CLK_INGENIC
	bool
	depends on MACH_XBURST2
	select MFD_SYSCON
	select INGENIC_CLK_DEBUG_FS

config INGENIC_CLK_DEBUG_FS
	bool
	depends on DEBUG_FS
	help
	  enable ingenic common clock debugfs

config CLK_X2000
	bool "clk x2000"
	depends on SOC_X2000
	select COMMON_CLK_INGENIC
	help
	  build the ingenic x2000 soc clock driver.

config CLK_X2000_CPU_MHZ
	int "x2000 CPU clock in MHz (0: as the boot loader left it)"
	depends on CLK_X2000
	range 0 1200
	default 0
	help
	  Reprograms the APLL, which feeds only the CPU and its L2 cache, to
	  this frequency before the clocks are registered. It must be a
	  multiple of 24 from 600 to 1200.

	  The boot loaders run the X2000 at 1200 MHz. At that speed the
	  Creality K1 computes wrong floating point results now and then
	  (a few in a million repetitions of a fixed calculation on one CPU,
	  a few in a thousand with both CPUs busy), more when the board is
	  warm; the same kernel and the same program give none at 750 or
	  912 MHz. Klipper turns such a result into a step that lies before
	  the previous one and shuts the printer down.
```

## module_drivers/drivers/clocksource/Kconfig
```kconfig
# SPDX-License-Identifier: GPL-2.0
config CLKSRC_INGENIC_CORE_OST
	bool "Core OST clocksource."
	select TIMER_OF
	depends on SOC_X2000
	help
	  core sys ost for ingenic xburst2 based SOCs. each cpu has
	  an ost and all cpu shares a global clocksource.
```

## module_drivers/drivers/dma/ingenic/Kconfig
```kconfig
# SPDX-License-Identifier: GPL-2.0
config INGENIC_PDMAC
	bool "Ingenic programmable dma controller (Of Driver)"
	depends on MACH_XBURST2
	select DMA_VIRTUAL_CHANNELS
	select DMA_ENGINE
	help
	  This selects support for the DMA controller in Ingenic X1000 M200 SoCs.
	  If you have a board based on such a SoC and wish to use DMA for
	  devices which can use the DMA controller, say Y or M here.
```

## module_drivers/drivers/irqchip/Kconfig
```kconfig
# SPDX-License-Identifier: GPL-2.0
config IRQ_INGENIC_CPU
	bool "cpu interrupt driver"
	depends on SOC_X2000
	select IRQ_DOMAIN
	help
	  Support for ingenic cpu core irq handler.

config INGENIC_INTC_CHIP
	bool "intc v2 interrupt driver"
	depends on IRQ_INGENIC_CPU
	select IRQ_DOMAIN
	help
	  Support for ingenic XBURST2 based SOCs, which intc is
	  near cpu core,and each logic cpu has an intc.
```

## module_drivers/drivers/mfd/Kconfig
```kconfig
# SPDX-License-Identifier: GPL-2.0
config MFD_INGENIC_TCU
	bool "[TCU] Ingenic tcu driver"
	select MFD_CORE
	select GENERIC_IRQ_CHIP
	depends on SOC_X2000
	help
	  Say yes here if you want support for the TCU unit in the ingenic SoC.
	  This driver is necessary for ingenic pwm or counter.
```

## module_drivers/drivers/mmc/host/Kconfig
```kconfig
# SPDX-License-Identifier: GPL-2.0
config MMC_SDHCI_INGENIC
	tristate "Ingenic(XBurst2)  MMC/SD Card Controller(MSC) support"
	depends on SOC_X2000
	select MMC_SDHCI
	depends on MMC
	help
	  This selects the Ingenic XBurst2 SD/MMC Card Controller MSC.
	  If you have platform with a SD/Multimedia Card slot and compact
	  with this version, say Y or M here.
	  If unsure, say N.
```

## module_drivers/drivers/rtc/Kconfig
```kconfig
# SPDX-License-Identifier: GPL-2.0
config RTC_DRV_INGENIC
	tristate "INGENIC RTC"
	help
	  If you say Y here you will get access to the real time clock
	  built into your INGENIC CPU.

	  To compile this driver as a module, choose M here: the
	  module will be called rtc-ingenic.
```

## module_drivers/drivers/watchdog/Kconfig
```kconfig
# SPDX-License-Identifier: GPL-2.0
config INGENIC_WDT
	tristate "Ingenic ingenic SoC hardware watchdog"
	depends on SOC_X2000
	select WATCHDOG_CORE
	help
	  Hardware driver for the built-in watchdog timer on Ingenic all SoCs.
```

## sound/soc/jz4740/Kconfig
```kconfig
# SPDX-License-Identifier: GPL-2.0-only
menu "JZ4740"

config SND_JZ4740_SOC_I2S
	tristate "SoC Audio (I2S protocol) for Ingenic JZ4740 SoC"
	depends on MIPS || COMPILE_TEST
	depends on HAS_IOMEM
	select REGMAP_MMIO
	select SND_SOC_GENERIC_DMAENGINE_PCM
	help
	  Say Y if you want to use I2S protocol and I2S codec on Ingenic JZ4740
	  based boards.

config SND_X2000_SOC_AS
	tristate "SoC Audio playback for Ingenic X2000 Audio System v2"
	depends on MIPS || COMPILE_TEST
	depends on HAS_IOMEM
	help
	  Say Y to enable playback through the Ingenic X2000 Audio System v2
	  (AS DMA, FIFO, format converter, DBUS and BAIC0) to the internal
	  audio codec.

endmenu
```
