## Documentation/devicetree/bindings/interrupt-controller/ingenic,intc.yaml
```yaml
# SPDX-License-Identifier: (GPL-2.0-only OR BSD-2-Clause)
%YAML 1.2
---
$id: http://devicetree.org/schemas/interrupt-controller/ingenic,intc.yaml#
$schema: http://devicetree.org/meta-schemas/core.yaml#

title: Ingenic SoCs interrupt controller

maintainers:
  - Paul Cercueil <paul@crapouillou.net>

properties:
  $nodename:
    pattern: "^interrupt-controller@[0-9a-f]+$"

  compatible:
    oneOf:
      - enum:
          - ingenic,jz4740-intc
          - ingenic,jz4760-intc
          - ingenic,jz4780-intc
          - ingenic,x2000-intc
      - items:
          - enum:
              - ingenic,jz4775-intc
              - ingenic,jz4770-intc
              - ingenic,jz4760b-intc
          - const: ingenic,jz4760-intc
      - items:
          - const: ingenic,x1000-intc
          - const: ingenic,jz4780-intc
      - items:
          - const: ingenic,jz4725b-intc
          - const: ingenic,jz4740-intc

  "#interrupt-cells":
    const: 1

  reg:
    minItems: 1
    maxItems: 2

  interrupts:
    maxItems: 1

  interrupt-controller: true

required:
  - compatible
  - reg
  - interrupts
  - "#interrupt-cells"
  - interrupt-controller

allOf:
  - if:
      properties:
        compatible:
          contains:
            const: ingenic,x2000-intc
    then:
      properties:
        reg:
          description:
            The X2000's controller has a block of registers for each CPU,
            with a mask bit for every interrupt, and an interrupt goes to
            the CPU it is unmasked at. One entry for each CPU, in the CPUs'
            order. The CPU's interrupt line is the same on every CPU.
    else:
      properties:
        reg:
          maxItems: 1

additionalProperties: false

examples:
  - |
    intc: interrupt-controller@10001000 {
      compatible = "ingenic,jz4770-intc", "ingenic,jz4760-intc";
      reg = <0x10001000 0x40>;

      interrupt-controller;
      #interrupt-cells = <1>;

      interrupt-parent = <&cpuintc>;
      interrupts = <2>;
    };

  - |
    interrupt-controller@12300000 {
      compatible = "ingenic,x2000-intc";
      reg = <0x12300000 0x100>, <0x12300100 0x100>;

      interrupt-controller;
      #interrupt-cells = <1>;

      interrupt-parent = <&cpuintc>;
      interrupts = <2>;
    };
```

## Documentation/devicetree/bindings/sound/ingenic,x2000-as.yaml
```yaml
# SPDX-License-Identifier: (GPL-2.0-only OR BSD-2-Clause)
%YAML 1.2
---
$id: http://devicetree.org/schemas/sound/ingenic,x2000-as.yaml#
$schema: http://devicetree.org/meta-schemas/core.yaml#

title: Ingenic X2000 Audio System v2

maintainers:
  - Datel OS <datel-os@users.noreply.github.com>

properties:
  compatible:
    const: ingenic,x2000-as

  reg:
    items:
      - description: AS DMA registers
      - description: AS FIFO registers
      - description: AS format converter registers
      - description: AS DSP/DBUS routing registers
      - description: BAIC0 registers

  reg-names:
    items:
      - const: dma
      - const: fifo
      - const: fmtcov
      - const: dsp
      - const: baic

  interrupts:
    maxItems: 1

  clocks:
    items:
      - description: Audio system AHB2 bus clock
      - description: BAIC0 clock gate
      - description: I2S TX clock

  clock-names:
    items:
      - const: audio
      - const: baic0
      - const: i2s_tx

  "#sound-dai-cells":
    const: 0

required:
  - compatible
  - reg
  - reg-names
  - interrupts
  - clocks
  - clock-names
  - "#sound-dai-cells"

additionalProperties: false
```

## Documentation/devicetree/bindings/sound/ingenic,x2000-icodec.yaml
```yaml
# SPDX-License-Identifier: (GPL-2.0-only OR BSD-2-Clause)
%YAML 1.2
---
$id: http://devicetree.org/schemas/sound/ingenic,x2000-icodec.yaml#
$schema: http://devicetree.org/meta-schemas/core.yaml#

title: Ingenic X2000 Internal Audio CODEC

maintainers:
  - Datel OS <datel-os@users.noreply.github.com>

properties:
  compatible:
    const: ingenic,x2000-icodec

  reg:
    maxItems: 1

  "#sound-dai-cells":
    const: 0

required:
  - compatible
  - reg
  - "#sound-dai-cells"

additionalProperties: false
```

## Documentation/devicetree/bindings/timer/ingenic,sysost.yaml
```yaml
# SPDX-License-Identifier: (GPL-2.0-only OR BSD-2-Clause)
%YAML 1.2
---
$id: http://devicetree.org/schemas/timer/ingenic,sysost.yaml#
$schema: http://devicetree.org/meta-schemas/core.yaml#

title: SYSOST in Ingenic XBurst family SoCs

maintainers:
  - 周琰杰 (Zhou Yanjie) <zhouyanjie@wanyeetech.com>

description:
  The SYSOST in an Ingenic SoC provides one 64bit timer for clocksource
  and one or more 32bit timers for clockevent. In the X2000 the 64bit timer
  and each CPU's 32bit timer are register blocks of their own, and the
  interrupt is a line of each CPU.

properties:
  "#clock-cells":
    const: 1

  compatible:
    enum:
      - ingenic,x1000-ost
      - ingenic,x2000-ost

  reg:
    minItems: 1
    maxItems: 5
    description:
      The registers. For the X2000, the 64bit timer's first, then the 32bit
      timer's of each CPU, in the CPUs' order.

  clocks:
    maxItems: 1

  clock-names:
    const: ost

  interrupts:
    maxItems: 1

required:
  - compatible
  - reg
  - clocks
  - clock-names
  - interrupts

allOf:
  - if:
      properties:
        compatible:
          contains:
            const: ingenic,x2000-ost
    then:
      properties:
        "#clock-cells": false
        reg:
          minItems: 2
    else:
      properties:
        reg:
          maxItems: 1
      required:
        - "#clock-cells"

additionalProperties: false

examples:
  - |
    #include <dt-bindings/clock/ingenic,x1000-cgu.h>

    ost: timer@12000000 {
        compatible = "ingenic,x1000-ost";
        reg = <0x12000000 0x3c>;

        #clock-cells = <1>;

        clocks = <&cgu X1000_CLK_OST>;
        clock-names = "ost";

        interrupt-parent = <&cpuintc>;
        interrupts = <3>;
    };

  - |
    #include <dt-bindings/clock/ingenic,x2000-cgu.h>

    timer@12000000 {
        compatible = "ingenic,x2000-ost";
        reg = <0x12000000 0x18>,
              <0x12100000 0x100>,
              <0x12100100 0x100>;

        clocks = <&cgu X2000_CLK_OST>;
        clock-names = "ost";

        interrupt-parent = <&cpuintc>;
        interrupts = <4>;
    };
...
```

## arch/mips/configs/k1_defconfig
```kconfig
# CONFIG_LOCALVERSION_AUTO is not set
CONFIG_SYSVIPC=y
# CONFIG_CROSS_MEMORY_ATTACH is not set
CONFIG_NO_HZ_IDLE=y
CONFIG_HIGH_RES_TIMERS=y
CONFIG_PREEMPT=y
CONFIG_PSI=y
# CONFIG_CPU_ISOLATION is not set
CONFIG_IKCONFIG=y
CONFIG_IKCONFIG_PROC=y
CONFIG_CGROUPS=y
CONFIG_EXPERT=y
# CONFIG_SGETMASK_SYSCALL is not set
CONFIG_BASE_SMALL=y
# CONFIG_AIO is not set
# CONFIG_IO_URING is not set
# CONFIG_ADVISE_SYSCALLS is not set
CONFIG_MACH_XBURST2=y
CONFIG_CLK_X2000_CPU_MHZ=816
# CONFIG_PINCTRL_DUMP is not set
CONFIG_SERIAL_INGENIC_UART=y
CONFIG_SERIAL_INGENIC_CONSOLE=y
CONFIG_SERIAL_INGENIC_MAGIC_SYSRQ=y
CONFIG_CPU_MIPS32_R5=y
CONFIG_SMP=y
CONFIG_HOTPLUG_CPU=y
CONFIG_NR_CPUS=2
CONFIG_HZ_100=y
CONFIG_MIPS_CMDLINE_FROM_BOOTLOADER=y
# CONFIG_SUSPEND is not set
# CONFIG_SECCOMP is not set
# CONFIG_STACKPROTECTOR is not set
# CONFIG_GCC_PLUGINS is not set
CONFIG_MODULES=y
CONFIG_MODULE_FORCE_LOAD=y
CONFIG_MODULE_UNLOAD=y
CONFIG_MODULE_FORCE_UNLOAD=y
CONFIG_BLK_DEV_INTEGRITY=y
# CONFIG_BLK_DEBUG_FS is not set
CONFIG_PARTITION_ADVANCED=y
# CONFIG_IOSCHED_BFQ is not set
# CONFIG_COREDUMP is not set
# CONFIG_COMPAT_BRK is not set
# CONFIG_COMPACTION is not set
CONFIG_LRU_GEN=y
CONFIG_LRU_GEN_ENABLED=y
CONFIG_NET=y
CONFIG_PACKET=y
CONFIG_UNIX=y
CONFIG_INET=y
CONFIG_IP_MULTICAST=y
CONFIG_IP_PNP=y
CONFIG_IP_PNP_DHCP=y
CONFIG_IP_PNP_BOOTP=y
CONFIG_IP_PNP_RARP=y
# CONFIG_IPV6 is not set
CONFIG_NETWORK_PHY_TIMESTAMPING=y
# CONFIG_PCPU_DEV_REFCNT is not set
CONFIG_BT=y
CONFIG_BT_HCIUART=y
CONFIG_BT_HCIUART_3WIRE=y
CONFIG_BT_HCIUART_BCM=y
CONFIG_CFG80211=y
CONFIG_CFG80211_WEXT=y
CONFIG_RFKILL=y
CONFIG_UEVENT_HELPER=y
CONFIG_UEVENT_HELPER_PATH="/sbin/hotplug"
CONFIG_DEVTMPFS=y
CONFIG_DEVTMPFS_MOUNT=y
# CONFIG_STANDALONE is not set
# CONFIG_PREVENT_FIRMWARE_BUILD is not set
# CONFIG_ALLOW_DEV_COREDUMP is not set
CONFIG_ZRAM=y
CONFIG_ZRAM_BACKEND_LZ4=y
CONFIG_EEPROM_AT24=y
CONFIG_SCSI=y
CONFIG_BLK_DEV_SD=y
# CONFIG_BLK_DEV_BSG is not set
CONFIG_NETDEVICES=y
CONFIG_VETH=y
# CONFIG_ETHERNET is not set
CONFIG_PHYLIB=y
CONFIG_USB_USBNET=m
# CONFIG_USB_NET_AX8817X is not set
# CONFIG_USB_NET_CDCETHER is not set
# CONFIG_USB_NET_CDC_NCM is not set
# CONFIG_USB_NET_NET1080 is not set
# CONFIG_USB_NET_CDC_SUBSET is not set
# CONFIG_USB_NET_ZAURUS is not set
# CONFIG_WLAN_VENDOR_ADMTEK is not set
# CONFIG_WLAN_VENDOR_ATH is not set
# CONFIG_WLAN_VENDOR_ATMEL is not set
CONFIG_BRCMFMAC=m
# CONFIG_WLAN_VENDOR_INTEL is not set
# CONFIG_WLAN_VENDOR_INTERSIL is not set
# CONFIG_WLAN_VENDOR_MARVELL is not set
# CONFIG_WLAN_VENDOR_MEDIATEK is not set
# CONFIG_WLAN_VENDOR_MICROCHIP is not set
# CONFIG_WLAN_VENDOR_PURELIFI is not set
# CONFIG_WLAN_VENDOR_RALINK is not set
# CONFIG_WLAN_VENDOR_REALTEK is not set
# CONFIG_WLAN_VENDOR_RSI is not set
# CONFIG_WLAN_VENDOR_SILABS is not set
# CONFIG_WLAN_VENDOR_ST is not set
# CONFIG_WLAN_VENDOR_TI is not set
# CONFIG_WLAN_VENDOR_ZYDAS is not set
# CONFIG_WLAN_VENDOR_QUANTENNA is not set
CONFIG_INPUT_MOUSEDEV=y
CONFIG_INPUT_EVDEV=y
# CONFIG_KEYBOARD_ATKBD is not set
CONFIG_KEYBOARD_GPIO=y
# CONFIG_INPUT_MOUSE is not set
CONFIG_INPUT_TOUCHSCREEN=y
CONFIG_TOUCHSCREEN_GOODIX=y
# CONFIG_SERIO_SERPORT is not set
# CONFIG_LEGACY_PTYS is not set
# CONFIG_LEGACY_TIOCSTI is not set
# CONFIG_LDISC_AUTOLOAD is not set
CONFIG_SERIAL_DEV_BUS=y
CONFIG_TTY_PRINTK=y
CONFIG_HW_RANDOM=y
CONFIG_I2C_CHARDEV=y
CONFIG_SPI=y
CONFIG_SPI_GPIO=y
CONFIG_SPI_SPIDEV=y
CONFIG_GPIO_SYSFS=y
# CONFIG_HWMON is not set
CONFIG_WATCHDOG=y
CONFIG_WATCHDOG_CORE=y
CONFIG_REGULATOR=y
CONFIG_REGULATOR_FIXED_VOLTAGE=y
CONFIG_MEDIA_SUPPORT=y
CONFIG_MEDIA_SUPPORT_FILTER=y
CONFIG_MEDIA_CAMERA_SUPPORT=y
CONFIG_MEDIA_PLATFORM_SUPPORT=y
CONFIG_MEDIA_USB_SUPPORT=y
CONFIG_USB_GSPCA=y
CONFIG_USB_GSPCA_CONEX=y
CONFIG_USB_GSPCA_JEILINJ=y
CONFIG_USB_GSPCA_MARS=y
CONFIG_USB_GSPCA_OV519=y
CONFIG_USB_GSPCA_OV534=y
CONFIG_USB_GSPCA_OV534_9=y
CONFIG_USB_GSPCA_SN9C20X=y
CONFIG_USB_GSPCA_SONIXJ=y
CONFIG_USB_GSPCA_SPCA500=y
CONFIG_USB_GSPCA_STK014=y
CONFIG_USB_GSPCA_SUNPLUS=y
CONFIG_USB_GSPCA_T613=y
CONFIG_USB_GSPCA_TOPRO=y
CONFIG_USB_GSPCA_VC032X=y
CONFIG_USB_GSPCA_ZC3XX=y
CONFIG_USB_PWC=y
CONFIG_USB_VIDEO_CLASS=y
CONFIG_V4L_PLATFORM_DRIVERS=y
CONFIG_V4L_MEM2MEM_DRIVERS=y
# CONFIG_HID_GENERIC is not set
# CONFIG_I2C_HID is not set
# CONFIG_USB_HID is not set
CONFIG_USB_KBD=y
CONFIG_USB_MOUSE=y
CONFIG_USB=y
CONFIG_USB_ANNOUNCE_NEW_DEVICES=y
CONFIG_USB_STORAGE=y
CONFIG_USB_DWC2=y
CONFIG_MMC=y
CONFIG_MMC_BLOCK_MINORS=16
CONFIG_MMC_SDHCI=y
CONFIG_RTC_CLASS=y
# CONFIG_RTC_NVMEM is not set
CONFIG_DMADEVICES=y
# CONFIG_VIRTIO_MENU is not set
# CONFIG_VHOST_MENU is not set
# CONFIG_MIPS_PLATFORM_DEVICES is not set
# CONFIG_IOMMU_SUPPORT is not set
CONFIG_EXTCON=y
CONFIG_EXT4_FS=y
CONFIG_EXT4_FS_SECURITY=y
# CONFIG_DNOTIFY is not set
CONFIG_AUTOFS_FS=y
CONFIG_VFAT_FS=y
CONFIG_EXFAT_FS=y
CONFIG_PROC_KCORE=y
# CONFIG_PROC_PAGE_MONITOR is not set
CONFIG_TMPFS=y
CONFIG_TMPFS_POSIX_ACL=y
CONFIG_SQUASHFS=y
CONFIG_SQUASHFS_XZ=y
CONFIG_SQUASHFS_ZSTD=y
CONFIG_PSTORE=y
# CONFIG_PSTORE_COMPRESS is not set
CONFIG_PSTORE_CONSOLE=y
CONFIG_PSTORE_PMSG=y
CONFIG_PSTORE_RAM=y
# CONFIG_NETWORK_FILESYSTEMS is not set
CONFIG_NLS_CODEPAGE_437=y
CONFIG_NLS_ASCII=y
CONFIG_NLS_ISO8859_1=y
CONFIG_NLS_UTF8=y
CONFIG_INIT_STACK_NONE=y
CONFIG_CRYPTO_NULL=y
CONFIG_CRYPTO_SEQIV=y
CONFIG_CRYPTO_CRC32C=y
CONFIG_CRYPTO_LZO=y
CONFIG_CRYPTO_LZ4=y
CONFIG_PRINTK_TIME=y
# CONFIG_DEBUG_MISC is not set
CONFIG_FRAME_WARN=1024
# CONFIG_SECTION_MISMATCH_WARN_ONLY is not set
CONFIG_MAGIC_SYSRQ=y
CONFIG_DEBUG_FS=y
CONFIG_PANIC_TIMEOUT=10
CONFIG_BOOTPARAM_SOFTLOCKUP_PANIC=y
CONFIG_HARDLOCKUP_DETECTOR=y
CONFIG_BOOTPARAM_HARDLOCKUP_PANIC=y
CONFIG_WQ_WATCHDOG=y
CONFIG_SCHEDSTATS=y
# CONFIG_RCU_TRACE is not set
# CONFIG_FTRACE is not set
CONFIG_CMDLINE_BOOL=y
CONFIG_CMDLINE="ieee754=relaxed"
CONFIG_DEBUG_ZBOOT=y
CONFIG_ZBOOT_INGENIC_UART=2
# CONFIG_RUNTIME_TESTING_MENU is not set
```

## arch/mips/ingenic/Kconfig
```kconfig
# SPDX-License-Identifier: GPL-2.0

config MACH_INGENIC_GENERIC
	bool
	select MACH_INGENIC
	select MACH_JZ4740
	select MACH_JZ4725B
	select MACH_JZ4770
	select MACH_JZ4780
	select MACH_X1000
	select MACH_X1830

choice
	prompt "Machine type"
	depends on MACH_INGENIC_SOC
	default INGENIC_GENERIC_BOARD

config INGENIC_GENERIC_BOARD
	bool "Generic board"
	select MACH_INGENIC_GENERIC

config JZ4740_QI_LB60
	bool "Qi Hardware Ben NanoNote"
	select MACH_JZ4740

config JZ4740_RS90
	bool "YLM RetroMini (RS-90)"
	select MACH_JZ4725B

config JZ4770_GCW0
	bool "Game Consoles Worldwide GCW Zero"
	select MACH_JZ4770

config JZ4780_CI20
	bool "MIPS Creator CI20"
	select MACH_JZ4780

config X1000_CU1000_NEO
	bool "YSH & ATIL CU1000 Module with Neo backplane"
	select MACH_X1000

config X1830_CU1830_NEO
	bool "YSH & ATIL CU1830 Module with Neo backplane"
	select MACH_X1830

config X2000_CREALITY_K1
	bool "Creality K1"
	select MACH_X2000

endchoice

config MACH_JZ4725B
	bool
	select SYS_HAS_CPU_MIPS32_R1

config MACH_JZ4740
	bool
	select SYS_HAS_CPU_MIPS32_R1

config MACH_JZ4770
	bool
	select MIPS_CPU_SCACHE
	select SYS_HAS_CPU_MIPS32_R2
	select SYS_SUPPORTS_HIGHMEM

config MACH_JZ4780
	bool
	select MIPS_CPU_SCACHE
	select SYS_HAS_CPU_MIPS32_R2
	select SYS_SUPPORTS_HIGHMEM

config MACH_X1000
	bool
	select MIPS_CPU_SCACHE
	select SYS_HAS_CPU_MIPS32_R2
	select SYS_SUPPORTS_HIGHMEM

config MACH_X1830
	bool
	select MIPS_CPU_SCACHE
	select SYS_HAS_CPU_MIPS32_R2
	select SYS_SUPPORTS_HIGHMEM

# The X2000's CPU is an XBurst2: two CPUs that are threads of one core, of
# MIPS32 release 5 without ERETNC. What its CPU feature overrides say holds
# for it alone, so it is not part of the generic board's kernel. No CPU
# hotplug: see arch/mips/kernel/smp-xburst2.c.
config MACH_X2000
	bool
	select HARDIRQS_SW_RESEND
	select MIPS_O32_FP64_SUPPORT
	select SMP_UP if SMP
	select SYS_HAS_CPU_MIPS32_R2
	select SYS_HAS_CPU_MIPS32_R5
	select SYS_SUPPORTS_HIGHMEM
	select SYS_SUPPORTS_SMP
	select WEAK_ORDERING
	select WEAK_REORDERING_BEYOND_LLSC
	select XBURST2_CPU_SCACHE

config XBURST2_SMP
	def_bool SMP && MACH_X2000
```

## drivers/gpu/drm/ingenic/Kconfig
```kconfig
config DRM_INGENIC
	tristate "DRM Support for Ingenic SoCs"
	depends on MIPS || COMPILE_TEST
	depends on DRM
	depends on CMA
	depends on OF
	depends on COMMON_CLK
	select DRM_BRIDGE
	select DRM_CLIENT_SELECTION
	select DRM_PANEL_BRIDGE
	select DRM_KMS_HELPER
	select DRM_DISPLAY_HELPER
	select DRM_BRIDGE_CONNECTOR
	select DRM_GEM_DMA_HELPER
	select REGMAP
	select REGMAP_MMIO
	help
	  Choose this option for DRM support for the Ingenic SoCs.

	  If M is selected the module will be called ingenic-drm.

config DRM_INGENIC_X2000_DPU
	tristate "DRM Support for the Ingenic X2000 display controller"
	depends on MIPS || COMPILE_TEST
	depends on DRM
	depends on OF
	depends on COMMON_CLK
	select DRM_BRIDGE
	select DRM_CLIENT_SELECTION
	select DRM_PANEL_BRIDGE
	select DRM_KMS_HELPER
	select DRM_GEM_DMA_HELPER
	help
	  Choose this option for the display controller (DPU) of the Ingenic
	  X2000. It drives a parallel RGB panel from one plane.

	  If M is selected the module will be called ingenic-x2000-dpu.

if DRM_INGENIC

config DRM_INGENIC_IPU
	bool "IPU support for Ingenic SoCs"
	help
	  Choose this option to enable support for the IPU found in Ingenic SoCs.

	  The Image Processing Unit (IPU) will appear as a second primary plane.

config DRM_INGENIC_DW_HDMI
	tristate "Ingenic specific support for Synopsys DW HDMI"
	depends on MACH_JZ4780
	select DRM_DW_HDMI
	help
	  Choose this option to enable Synopsys DesignWare HDMI based driver.
	  If you want to enable HDMI on Ingenic JZ4780 based SoC, you should
	  select this option.

endif
```
